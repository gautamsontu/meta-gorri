## conf/layer.conf
```bitbake
# We have a conf and classes directory, add to BBPATH
BBPATH .= ":${LAYERDIR}"

# We have recipes-* directories, add to BBFILES
BBFILES += "${LAYERDIR}/recipes-*/*/*.bb \
            ${LAYERDIR}/recipes-*/*/*.bbappend"

BBFILE_COLLECTIONS += "meta-gorri"
BBFILE_PATTERN_meta-gorri = "^${LAYERDIR}/"
BBFILE_PRIORITY_meta-gorri = "6"

LAYERDEPENDS_meta-gorri = "core"
LAYERSERIES_COMPAT_meta-gorri = "kirkstone"
```
